## broadcom/Kconfig
```kconfig
menu "BROADCOM V4L2 BT/FM device drivers"
  depends on BT

config BCM_COMBO_BT_PROTOCOL
	tristate "BROADCOM BT Protocol Driver"
	select BCM_COMBO_LINE_DISCIPLINE
	default n

config BCM_COMBO_LINE_DISCIPLINE
	tristate "BROADCOM Line Discipline Driver"
	select FW_LOADER
	default n

config BCM_COMBO_V4L2_FM
	tristate "BROADCOM V4L2 FM Driver"
	select VIDEO_V4L2
	select BCM_COMBO_LINE_DISCIPLINE
	default n

endmenu
```
